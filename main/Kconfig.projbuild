## main/Kconfig.projbuild
```kconfig
menu "Application config"
    config APP_DEVICE_NAME
        string "RainMaker device name"
        default "HM IO Connect"

    config APP_DEVICE_TYPE
        string "RainMaker device type"
        default "Device Hub"

    config BOARD_BUTTON_GPIO
        int "Boot Button GPIO"
        default 0 if !IDF_TARGET_ESP32C3
        default 9 if IDF_TARGET_ESP32C3
        help
            GPIO number on which the "Boot" button is connected. This is generally used
            by the application for custom operations like toggling states, resetting to defaults, etc.

    config I2C_SDA_GPIO
        int "I2C SDA GPIO"
        default 21

    config I2C_SCL_GPIO
        int "I2C SCL GPIO"
        default 22

    config RELAY_0_OUTPUT_GPIO
        int "Relay 0 output GPIO"
        default 19

    config RELAY_1_OUTPUT_GPIO
        int "Relay 1 output GPIO"
        default 18

    config RELAY_2_OUTPUT_GPIO
        int "Relay 2 output GPIO"
        default 17

    config RELAY_3_OUTPUT_GPIO
        int "Relay 3 output GPIO"
        default 16

    config RGBPIXEL_STRIP_OUTPUT_GPIO
        int "RGB strip output GPIO"
        default 5
endmenu
```

## sdkconfig.defaults
```kconfig
# Custom partition table
CONFIG_ESPTOOLPY_FLASHSIZE_4MB=y
CONFIG_PARTITION_TABLE_SINGLE_APP=
CONFIG_PARTITION_TABLE_TWO_OTA=
CONFIG_PARTITION_TABLE_CUSTOM=y
CONFIG_PARTITION_TABLE_CUSTOM_FILENAME="partitions.csv"
CONFIG_PARTITION_TABLE_FILENAME="partitions.csv"
CONFIG_PARTITION_TABLE_OFFSET=0x8000
CONFIG_PARTITION_TABLE_MD5=y

# Enable support for power management
CONFIG_ESP32_DEFAULT_CPU_FREQ_240=y

# mbedtls
CONFIG_MBEDTLS_DYNAMIC_BUFFER=y
CONFIG_MBEDTLS_DYNAMIC_FREE_PEER_CERT=y
CONFIG_MBEDTLS_DYNAMIC_FREE_CONFIG_DATA=y
CONFIG_MBEDTLS_CERTIFICATE_BUNDLE_DEFAULT_CMN=y
CONFIG_MBEDTLS_TLS_CLIENT_ONLY=y

# WiFi provisioning
CONFIG_APP_WIFI_PROV_TYPE_BLE=y
CONFIG_APP_WIFI_PROV_TYPE_SOFT_AP=n
CONFIG_APP_WIFI_SHOW_DEMO_INTRO_TEXT=y

# For BLE Provisioning using NimBLE stack (Not applicable for ESP32-S2)
CONFIG_BT_ENABLED=y
CONFIG_BTDM_CTRL_MODE_BLE_ONLY=y
CONFIG_BT_NIMBLE_ENABLED=y

# WS2812
CONFIG_WS2812_LED_ENABLE=y

# Temporary Fix for Timer Overflows
CONFIG_FREERTOS_TIMER_TASK_STACK_DEPTH=3120

# Fix for IRAM overflow
CONFIG_FREERTOS_PLACE_FUNCTIONS_INTO_FLASH=y

# ESP insights
CONFIG_ESP_INSIGHTS_ENABLED=y 
CONFIG_ESP32_ENABLE_COREDUMP=y
CONFIG_ESP32_ENABLE_COREDUMP_TO_FLASH=y
CONFIG_ESP32_COREDUMP_DATA_FORMAT_ELF=y
CONFIG_ESP32_COREDUMP_CHECKSUM_CRC32=y
CONFIG_ESP32_CORE_DUMP_MAX_TASKS_NUM=64

# RainMaker
CONFIG_ESP_RMAKER_MAX_NODE_CONFIG_SIZE=4096
CONFIG_ESP_RMAKER_DEF_TIMEZONE="Europe/Bucharest"
CONFIG_ESP_RMAKER_SNTP_SERVER_NAME="pool.ntp.org"

# For additional security on reset to factory
CONFIG_ESP_RMAKER_USER_ID_CHECK=y

# Secure Local Control
CONFIG_ESP_RMAKER_LOCAL_CTRL_ENABLE=y
CONFIG_ESP_RMAKER_LOCAL_CTRL_SECURITY_1=y

# Optimization
CONFIG_COMPILER_OPTIMIZATION_SIZE=y
CONFIG_OPTIMIZATION_LEVEL_RELEASE=y
CONFIG_COMPILER_OPTIMIZATION_LEVEL_RELEASE=y

# Application Rollback
CONFIG_BOOTLOADER_APP_ROLLBACK_ENABLE=y
```
